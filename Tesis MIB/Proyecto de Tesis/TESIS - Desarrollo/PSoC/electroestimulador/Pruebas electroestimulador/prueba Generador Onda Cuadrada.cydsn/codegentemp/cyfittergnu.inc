/*******************************************************************************
* File Name: cyfittergnu.inc
* 
* PSoC Creator  4.4
*
* Description:
* 
* This file is automatically generated by PSoC Creator.
*
********************************************************************************
* Copyright (c) 2007-2020 Cypress Semiconductor.  All rights reserved.
* You may use this file only in accordance with the license, terms, conditions, 
* disclaimers, and limitations in the end user license agreement accompanying 
* the software package with which this file was provided.
********************************************************************************/

.ifndef INCLUDED_CYFITTERGNU_INC
.set INCLUDED_CYFITTERGNU_INC, 1
.include "cydevicegnu_trm.inc"

/* LCD */
.set LCD_LCDPort__0__DM__MASK, 0x07
.set LCD_LCDPort__0__DM__SHIFT, 0
.set LCD_LCDPort__0__DR, CYREG_PRT0_DR
.set LCD_LCDPort__0__HSIOM, CYREG_HSIOM_PORT_SEL0
.set LCD_LCDPort__0__HSIOM_MASK, 0x0000000F
.set LCD_LCDPort__0__HSIOM_SHIFT, 0
.set LCD_LCDPort__0__INTCFG, CYREG_PRT0_INTCFG
.set LCD_LCDPort__0__INTSTAT, CYREG_PRT0_INTSTAT
.set LCD_LCDPort__0__MASK, 0x01
.set LCD_LCDPort__0__PA__CFG0, CYREG_UDB_PA0_CFG0
.set LCD_LCDPort__0__PA__CFG1, CYREG_UDB_PA0_CFG1
.set LCD_LCDPort__0__PA__CFG10, CYREG_UDB_PA0_CFG10
.set LCD_LCDPort__0__PA__CFG11, CYREG_UDB_PA0_CFG11
.set LCD_LCDPort__0__PA__CFG12, CYREG_UDB_PA0_CFG12
.set LCD_LCDPort__0__PA__CFG13, CYREG_UDB_PA0_CFG13
.set LCD_LCDPort__0__PA__CFG14, CYREG_UDB_PA0_CFG14
.set LCD_LCDPort__0__PA__CFG2, CYREG_UDB_PA0_CFG2
.set LCD_LCDPort__0__PA__CFG3, CYREG_UDB_PA0_CFG3
.set LCD_LCDPort__0__PA__CFG4, CYREG_UDB_PA0_CFG4
.set LCD_LCDPort__0__PA__CFG5, CYREG_UDB_PA0_CFG5
.set LCD_LCDPort__0__PA__CFG6, CYREG_UDB_PA0_CFG6
.set LCD_LCDPort__0__PA__CFG7, CYREG_UDB_PA0_CFG7
.set LCD_LCDPort__0__PA__CFG8, CYREG_UDB_PA0_CFG8
.set LCD_LCDPort__0__PA__CFG9, CYREG_UDB_PA0_CFG9
.set LCD_LCDPort__0__PC, CYREG_PRT0_PC
.set LCD_LCDPort__0__PC2, CYREG_PRT0_PC2
.set LCD_LCDPort__0__PORT, 0
.set LCD_LCDPort__0__PS, CYREG_PRT0_PS
.set LCD_LCDPort__0__SHIFT, 0
.set LCD_LCDPort__1__DM__MASK, 0x38
.set LCD_LCDPort__1__DM__SHIFT, 3
.set LCD_LCDPort__1__DR, CYREG_PRT0_DR
.set LCD_LCDPort__1__HSIOM, CYREG_HSIOM_PORT_SEL0
.set LCD_LCDPort__1__HSIOM_MASK, 0x000000F0
.set LCD_LCDPort__1__HSIOM_SHIFT, 4
.set LCD_LCDPort__1__INTCFG, CYREG_PRT0_INTCFG
.set LCD_LCDPort__1__INTSTAT, CYREG_PRT0_INTSTAT
.set LCD_LCDPort__1__MASK, 0x02
.set LCD_LCDPort__1__PA__CFG0, CYREG_UDB_PA0_CFG0
.set LCD_LCDPort__1__PA__CFG1, CYREG_UDB_PA0_CFG1
.set LCD_LCDPort__1__PA__CFG10, CYREG_UDB_PA0_CFG10
.set LCD_LCDPort__1__PA__CFG11, CYREG_UDB_PA0_CFG11
.set LCD_LCDPort__1__PA__CFG12, CYREG_UDB_PA0_CFG12
.set LCD_LCDPort__1__PA__CFG13, CYREG_UDB_PA0_CFG13
.set LCD_LCDPort__1__PA__CFG14, CYREG_UDB_PA0_CFG14
.set LCD_LCDPort__1__PA__CFG2, CYREG_UDB_PA0_CFG2
.set LCD_LCDPort__1__PA__CFG3, CYREG_UDB_PA0_CFG3
.set LCD_LCDPort__1__PA__CFG4, CYREG_UDB_PA0_CFG4
.set LCD_LCDPort__1__PA__CFG5, CYREG_UDB_PA0_CFG5
.set LCD_LCDPort__1__PA__CFG6, CYREG_UDB_PA0_CFG6
.set LCD_LCDPort__1__PA__CFG7, CYREG_UDB_PA0_CFG7
.set LCD_LCDPort__1__PA__CFG8, CYREG_UDB_PA0_CFG8
.set LCD_LCDPort__1__PA__CFG9, CYREG_UDB_PA0_CFG9
.set LCD_LCDPort__1__PC, CYREG_PRT0_PC
.set LCD_LCDPort__1__PC2, CYREG_PRT0_PC2
.set LCD_LCDPort__1__PORT, 0
.set LCD_LCDPort__1__PS, CYREG_PRT0_PS
.set LCD_LCDPort__1__SHIFT, 1
.set LCD_LCDPort__2__DM__MASK, 0x1C0
.set LCD_LCDPort__2__DM__SHIFT, 6
.set LCD_LCDPort__2__DR, CYREG_PRT0_DR
.set LCD_LCDPort__2__HSIOM, CYREG_HSIOM_PORT_SEL0
.set LCD_LCDPort__2__HSIOM_MASK, 0x00000F00
.set LCD_LCDPort__2__HSIOM_SHIFT, 8
.set LCD_LCDPort__2__INTCFG, CYREG_PRT0_INTCFG
.set LCD_LCDPort__2__INTSTAT, CYREG_PRT0_INTSTAT
.set LCD_LCDPort__2__MASK, 0x04
.set LCD_LCDPort__2__PA__CFG0, CYREG_UDB_PA0_CFG0
.set LCD_LCDPort__2__PA__CFG1, CYREG_UDB_PA0_CFG1
.set LCD_LCDPort__2__PA__CFG10, CYREG_UDB_PA0_CFG10
.set LCD_LCDPort__2__PA__CFG11, CYREG_UDB_PA0_CFG11
.set LCD_LCDPort__2__PA__CFG12, CYREG_UDB_PA0_CFG12
.set LCD_LCDPort__2__PA__CFG13, CYREG_UDB_PA0_CFG13
.set LCD_LCDPort__2__PA__CFG14, CYREG_UDB_PA0_CFG14
.set LCD_LCDPort__2__PA__CFG2, CYREG_UDB_PA0_CFG2
.set LCD_LCDPort__2__PA__CFG3, CYREG_UDB_PA0_CFG3
.set LCD_LCDPort__2__PA__CFG4, CYREG_UDB_PA0_CFG4
.set LCD_LCDPort__2__PA__CFG5, CYREG_UDB_PA0_CFG5
.set LCD_LCDPort__2__PA__CFG6, CYREG_UDB_PA0_CFG6
.set LCD_LCDPort__2__PA__CFG7, CYREG_UDB_PA0_CFG7
.set LCD_LCDPort__2__PA__CFG8, CYREG_UDB_PA0_CFG8
.set LCD_LCDPort__2__PA__CFG9, CYREG_UDB_PA0_CFG9
.set LCD_LCDPort__2__PC, CYREG_PRT0_PC
.set LCD_LCDPort__2__PC2, CYREG_PRT0_PC2
.set LCD_LCDPort__2__PORT, 0
.set LCD_LCDPort__2__PS, CYREG_PRT0_PS
.set LCD_LCDPort__2__SHIFT, 2
.set LCD_LCDPort__3__DM__MASK, 0xE00
.set LCD_LCDPort__3__DM__SHIFT, 9
.set LCD_LCDPort__3__DR, CYREG_PRT0_DR
.set LCD_LCDPort__3__HSIOM, CYREG_HSIOM_PORT_SEL0
.set LCD_LCDPort__3__HSIOM_MASK, 0x0000F000
.set LCD_LCDPort__3__HSIOM_SHIFT, 12
.set LCD_LCDPort__3__INTCFG, CYREG_PRT0_INTCFG
.set LCD_LCDPort__3__INTSTAT, CYREG_PRT0_INTSTAT
.set LCD_LCDPort__3__MASK, 0x08
.set LCD_LCDPort__3__PA__CFG0, CYREG_UDB_PA0_CFG0
.set LCD_LCDPort__3__PA__CFG1, CYREG_UDB_PA0_CFG1
.set LCD_LCDPort__3__PA__CFG10, CYREG_UDB_PA0_CFG10
.set LCD_LCDPort__3__PA__CFG11, CYREG_UDB_PA0_CFG11
.set LCD_LCDPort__3__PA__CFG12, CYREG_UDB_PA0_CFG12
.set LCD_LCDPort__3__PA__CFG13, CYREG_UDB_PA0_CFG13
.set LCD_LCDPort__3__PA__CFG14, CYREG_UDB_PA0_CFG14
.set LCD_LCDPort__3__PA__CFG2, CYREG_UDB_PA0_CFG2
.set LCD_LCDPort__3__PA__CFG3, CYREG_UDB_PA0_CFG3
.set LCD_LCDPort__3__PA__CFG4, CYREG_UDB_PA0_CFG4
.set LCD_LCDPort__3__PA__CFG5, CYREG_UDB_PA0_CFG5
.set LCD_LCDPort__3__PA__CFG6, CYREG_UDB_PA0_CFG6
.set LCD_LCDPort__3__PA__CFG7, CYREG_UDB_PA0_CFG7
.set LCD_LCDPort__3__PA__CFG8, CYREG_UDB_PA0_CFG8
.set LCD_LCDPort__3__PA__CFG9, CYREG_UDB_PA0_CFG9
.set LCD_LCDPort__3__PC, CYREG_PRT0_PC
.set LCD_LCDPort__3__PC2, CYREG_PRT0_PC2
.set LCD_LCDPort__3__PORT, 0
.set LCD_LCDPort__3__PS, CYREG_PRT0_PS
.set LCD_LCDPort__3__SHIFT, 3
.set LCD_LCDPort__4__DM__MASK, 0x7000
.set LCD_LCDPort__4__DM__SHIFT, 12
.set LCD_LCDPort__4__DR, CYREG_PRT0_DR
.set LCD_LCDPort__4__HSIOM, CYREG_HSIOM_PORT_SEL0
.set LCD_LCDPort__4__HSIOM_MASK, 0x000F0000
.set LCD_LCDPort__4__HSIOM_SHIFT, 16
.set LCD_LCDPort__4__INTCFG, CYREG_PRT0_INTCFG
.set LCD_LCDPort__4__INTSTAT, CYREG_PRT0_INTSTAT
.set LCD_LCDPort__4__MASK, 0x10
.set LCD_LCDPort__4__PA__CFG0, CYREG_UDB_PA0_CFG0
.set LCD_LCDPort__4__PA__CFG1, CYREG_UDB_PA0_CFG1
.set LCD_LCDPort__4__PA__CFG10, CYREG_UDB_PA0_CFG10
.set LCD_LCDPort__4__PA__CFG11, CYREG_UDB_PA0_CFG11
.set LCD_LCDPort__4__PA__CFG12, CYREG_UDB_PA0_CFG12
.set LCD_LCDPort__4__PA__CFG13, CYREG_UDB_PA0_CFG13
.set LCD_LCDPort__4__PA__CFG14, CYREG_UDB_PA0_CFG14
.set LCD_LCDPort__4__PA__CFG2, CYREG_UDB_PA0_CFG2
.set LCD_LCDPort__4__PA__CFG3, CYREG_UDB_PA0_CFG3
.set LCD_LCDPort__4__PA__CFG4, CYREG_UDB_PA0_CFG4
.set LCD_LCDPort__4__PA__CFG5, CYREG_UDB_PA0_CFG5
.set LCD_LCDPort__4__PA__CFG6, CYREG_UDB_PA0_CFG6
.set LCD_LCDPort__4__PA__CFG7, CYREG_UDB_PA0_CFG7
.set LCD_LCDPort__4__PA__CFG8, CYREG_UDB_PA0_CFG8
.set LCD_LCDPort__4__PA__CFG9, CYREG_UDB_PA0_CFG9
.set LCD_LCDPort__4__PC, CYREG_PRT0_PC
.set LCD_LCDPort__4__PC2, CYREG_PRT0_PC2
.set LCD_LCDPort__4__PORT, 0
.set LCD_LCDPort__4__PS, CYREG_PRT0_PS
.set LCD_LCDPort__4__SHIFT, 4
.set LCD_LCDPort__5__DM__MASK, 0x38000
.set LCD_LCDPort__5__DM__SHIFT, 15
.set LCD_LCDPort__5__DR, CYREG_PRT0_DR
.set LCD_LCDPort__5__HSIOM, CYREG_HSIOM_PORT_SEL0
.set LCD_LCDPort__5__HSIOM_MASK, 0x00F00000
.set LCD_LCDPort__5__HSIOM_SHIFT, 20
.set LCD_LCDPort__5__INTCFG, CYREG_PRT0_INTCFG
.set LCD_LCDPort__5__INTSTAT, CYREG_PRT0_INTSTAT
.set LCD_LCDPort__5__MASK, 0x20
.set LCD_LCDPort__5__PA__CFG0, CYREG_UDB_PA0_CFG0
.set LCD_LCDPort__5__PA__CFG1, CYREG_UDB_PA0_CFG1
.set LCD_LCDPort__5__PA__CFG10, CYREG_UDB_PA0_CFG10
.set LCD_LCDPort__5__PA__CFG11, CYREG_UDB_PA0_CFG11
.set LCD_LCDPort__5__PA__CFG12, CYREG_UDB_PA0_CFG12
.set LCD_LCDPort__5__PA__CFG13, CYREG_UDB_PA0_CFG13
.set LCD_LCDPort__5__PA__CFG14, CYREG_UDB_PA0_CFG14
.set LCD_LCDPort__5__PA__CFG2, CYREG_UDB_PA0_CFG2
.set LCD_LCDPort__5__PA__CFG3, CYREG_UDB_PA0_CFG3
.set LCD_LCDPort__5__PA__CFG4, CYREG_UDB_PA0_CFG4
.set LCD_LCDPort__5__PA__CFG5, CYREG_UDB_PA0_CFG5
.set LCD_LCDPort__5__PA__CFG6, CYREG_UDB_PA0_CFG6
.set LCD_LCDPort__5__PA__CFG7, CYREG_UDB_PA0_CFG7
.set LCD_LCDPort__5__PA__CFG8, CYREG_UDB_PA0_CFG8
.set LCD_LCDPort__5__PA__CFG9, CYREG_UDB_PA0_CFG9
.set LCD_LCDPort__5__PC, CYREG_PRT0_PC
.set LCD_LCDPort__5__PC2, CYREG_PRT0_PC2
.set LCD_LCDPort__5__PORT, 0
.set LCD_LCDPort__5__PS, CYREG_PRT0_PS
.set LCD_LCDPort__5__SHIFT, 5
.set LCD_LCDPort__6__DM__MASK, 0x1C0000
.set LCD_LCDPort__6__DM__SHIFT, 18
.set LCD_LCDPort__6__DR, CYREG_PRT0_DR
.set LCD_LCDPort__6__HSIOM, CYREG_HSIOM_PORT_SEL0
.set LCD_LCDPort__6__HSIOM_MASK, 0x0F000000
.set LCD_LCDPort__6__HSIOM_SHIFT, 24
.set LCD_LCDPort__6__INTCFG, CYREG_PRT0_INTCFG
.set LCD_LCDPort__6__INTSTAT, CYREG_PRT0_INTSTAT
.set LCD_LCDPort__6__MASK, 0x40
.set LCD_LCDPort__6__PA__CFG0, CYREG_UDB_PA0_CFG0
.set LCD_LCDPort__6__PA__CFG1, CYREG_UDB_PA0_CFG1
.set LCD_LCDPort__6__PA__CFG10, CYREG_UDB_PA0_CFG10
.set LCD_LCDPort__6__PA__CFG11, CYREG_UDB_PA0_CFG11
.set LCD_LCDPort__6__PA__CFG12, CYREG_UDB_PA0_CFG12
.set LCD_LCDPort__6__PA__CFG13, CYREG_UDB_PA0_CFG13
.set LCD_LCDPort__6__PA__CFG14, CYREG_UDB_PA0_CFG14
.set LCD_LCDPort__6__PA__CFG2, CYREG_UDB_PA0_CFG2
.set LCD_LCDPort__6__PA__CFG3, CYREG_UDB_PA0_CFG3
.set LCD_LCDPort__6__PA__CFG4, CYREG_UDB_PA0_CFG4
.set LCD_LCDPort__6__PA__CFG5, CYREG_UDB_PA0_CFG5
.set LCD_LCDPort__6__PA__CFG6, CYREG_UDB_PA0_CFG6
.set LCD_LCDPort__6__PA__CFG7, CYREG_UDB_PA0_CFG7
.set LCD_LCDPort__6__PA__CFG8, CYREG_UDB_PA0_CFG8
.set LCD_LCDPort__6__PA__CFG9, CYREG_UDB_PA0_CFG9
.set LCD_LCDPort__6__PC, CYREG_PRT0_PC
.set LCD_LCDPort__6__PC2, CYREG_PRT0_PC2
.set LCD_LCDPort__6__PORT, 0
.set LCD_LCDPort__6__PS, CYREG_PRT0_PS
.set LCD_LCDPort__6__SHIFT, 6
.set LCD_LCDPort__DR, CYREG_PRT0_DR
.set LCD_LCDPort__INTCFG, CYREG_PRT0_INTCFG
.set LCD_LCDPort__INTSTAT, CYREG_PRT0_INTSTAT
.set LCD_LCDPort__MASK, 0x7F
.set LCD_LCDPort__PA__CFG0, CYREG_UDB_PA0_CFG0
.set LCD_LCDPort__PA__CFG1, CYREG_UDB_PA0_CFG1
.set LCD_LCDPort__PA__CFG10, CYREG_UDB_PA0_CFG10
.set LCD_LCDPort__PA__CFG11, CYREG_UDB_PA0_CFG11
.set LCD_LCDPort__PA__CFG12, CYREG_UDB_PA0_CFG12
.set LCD_LCDPort__PA__CFG13, CYREG_UDB_PA0_CFG13
.set LCD_LCDPort__PA__CFG14, CYREG_UDB_PA0_CFG14
.set LCD_LCDPort__PA__CFG2, CYREG_UDB_PA0_CFG2
.set LCD_LCDPort__PA__CFG3, CYREG_UDB_PA0_CFG3
.set LCD_LCDPort__PA__CFG4, CYREG_UDB_PA0_CFG4
.set LCD_LCDPort__PA__CFG5, CYREG_UDB_PA0_CFG5
.set LCD_LCDPort__PA__CFG6, CYREG_UDB_PA0_CFG6
.set LCD_LCDPort__PA__CFG7, CYREG_UDB_PA0_CFG7
.set LCD_LCDPort__PA__CFG8, CYREG_UDB_PA0_CFG8
.set LCD_LCDPort__PA__CFG9, CYREG_UDB_PA0_CFG9
.set LCD_LCDPort__PC, CYREG_PRT0_PC
.set LCD_LCDPort__PC2, CYREG_PRT0_PC2
.set LCD_LCDPort__PORT, 0
.set LCD_LCDPort__PS, CYREG_PRT0_PS
.set LCD_LCDPort__SHIFT, 0

/* PWM */
.set PWM_PWMUDB_genblk1_ctrlreg__16BIT_CONTROL_AUX_CTL_REG, CYREG_UDB_W16_ACTL_02
.set PWM_PWMUDB_genblk1_ctrlreg__16BIT_CONTROL_CONTROL_REG, CYREG_UDB_W16_CTL_02
.set PWM_PWMUDB_genblk1_ctrlreg__16BIT_CONTROL_COUNT_REG, CYREG_UDB_W16_CTL_02
.set PWM_PWMUDB_genblk1_ctrlreg__16BIT_COUNT_CONTROL_REG, CYREG_UDB_W16_CTL_02
.set PWM_PWMUDB_genblk1_ctrlreg__16BIT_COUNT_COUNT_REG, CYREG_UDB_W16_CTL_02
.set PWM_PWMUDB_genblk1_ctrlreg__16BIT_MASK_MASK_REG, CYREG_UDB_W16_MSK_02
.set PWM_PWMUDB_genblk1_ctrlreg__16BIT_MASK_PERIOD_REG, CYREG_UDB_W16_MSK_02
.set PWM_PWMUDB_genblk1_ctrlreg__16BIT_PERIOD_MASK_REG, CYREG_UDB_W16_MSK_02
.set PWM_PWMUDB_genblk1_ctrlreg__16BIT_PERIOD_PERIOD_REG, CYREG_UDB_W16_MSK_02
.set PWM_PWMUDB_genblk1_ctrlreg__7__MASK, 0x80
.set PWM_PWMUDB_genblk1_ctrlreg__7__POS, 7
.set PWM_PWMUDB_genblk1_ctrlreg__CONTROL_AUX_CTL_REG, CYREG_UDB_W8_ACTL_02
.set PWM_PWMUDB_genblk1_ctrlreg__CONTROL_REG, CYREG_UDB_W8_CTL_02
.set PWM_PWMUDB_genblk1_ctrlreg__CONTROL_ST_REG, CYREG_UDB_CAT16_CTL_ST_02
.set PWM_PWMUDB_genblk1_ctrlreg__COUNT_REG, CYREG_UDB_W8_CTL_02
.set PWM_PWMUDB_genblk1_ctrlreg__COUNT_ST_REG, CYREG_UDB_CAT16_CTL_ST_02
.set PWM_PWMUDB_genblk1_ctrlreg__MASK, 0x80
.set PWM_PWMUDB_genblk1_ctrlreg__MASK_CTL_AUX_CTL_REG, CYREG_UDB_CAT16_ACTL_MSK_02
.set PWM_PWMUDB_genblk1_ctrlreg__PER_CTL_AUX_CTL_REG, CYREG_UDB_CAT16_ACTL_MSK_02
.set PWM_PWMUDB_genblk1_ctrlreg__PERIOD_REG, CYREG_UDB_W8_MSK_02
.set PWM_PWMUDB_genblk8_stsreg__0__MASK, 0x01
.set PWM_PWMUDB_genblk8_stsreg__0__POS, 0
.set PWM_PWMUDB_genblk8_stsreg__2__MASK, 0x04
.set PWM_PWMUDB_genblk8_stsreg__2__POS, 2
.set PWM_PWMUDB_genblk8_stsreg__3__MASK, 0x08
.set PWM_PWMUDB_genblk8_stsreg__3__POS, 3
.set PWM_PWMUDB_genblk8_stsreg__MASK, 0x0D
.set PWM_PWMUDB_genblk8_stsreg__MASK_REG, CYREG_UDB_W8_MSK_03
.set PWM_PWMUDB_genblk8_stsreg__STATUS_AUX_CTL_REG, CYREG_UDB_W8_ACTL_03
.set PWM_PWMUDB_genblk8_stsreg__STATUS_REG, CYREG_UDB_W8_ST_03
.set PWM_PWMUDB_sP16_pwmdp_u0__16BIT_A0_REG, CYREG_UDB_W16_A0_02
.set PWM_PWMUDB_sP16_pwmdp_u0__16BIT_A1_REG, CYREG_UDB_W16_A1_02
.set PWM_PWMUDB_sP16_pwmdp_u0__16BIT_D0_REG, CYREG_UDB_W16_D0_02
.set PWM_PWMUDB_sP16_pwmdp_u0__16BIT_D1_REG, CYREG_UDB_W16_D1_02
.set PWM_PWMUDB_sP16_pwmdp_u0__16BIT_DP_AUX_CTL_REG, CYREG_UDB_W16_ACTL_02
.set PWM_PWMUDB_sP16_pwmdp_u0__16BIT_F0_REG, CYREG_UDB_W16_F0_02
.set PWM_PWMUDB_sP16_pwmdp_u0__16BIT_F1_REG, CYREG_UDB_W16_F1_02
.set PWM_PWMUDB_sP16_pwmdp_u0__A0_A1_REG, CYREG_UDB_CAT16_A_02
.set PWM_PWMUDB_sP16_pwmdp_u0__A0_REG, CYREG_UDB_W8_A0_02
.set PWM_PWMUDB_sP16_pwmdp_u0__A1_REG, CYREG_UDB_W8_A1_02
.set PWM_PWMUDB_sP16_pwmdp_u0__D0_D1_REG, CYREG_UDB_CAT16_D_02
.set PWM_PWMUDB_sP16_pwmdp_u0__D0_REG, CYREG_UDB_W8_D0_02
.set PWM_PWMUDB_sP16_pwmdp_u0__D1_REG, CYREG_UDB_W8_D1_02
.set PWM_PWMUDB_sP16_pwmdp_u0__DP_AUX_CTL_REG, CYREG_UDB_W8_ACTL_02
.set PWM_PWMUDB_sP16_pwmdp_u0__F0_F1_REG, CYREG_UDB_CAT16_F_02
.set PWM_PWMUDB_sP16_pwmdp_u0__F0_REG, CYREG_UDB_W8_F0_02
.set PWM_PWMUDB_sP16_pwmdp_u0__F1_REG, CYREG_UDB_W8_F1_02
.set PWM_PWMUDB_sP16_pwmdp_u0__MSK_DP_AUX_CTL_REG, CYREG_UDB_CAT16_ACTL_MSK_02
.set PWM_PWMUDB_sP16_pwmdp_u0__PER_DP_AUX_CTL_REG, CYREG_UDB_CAT16_ACTL_MSK_02
.set PWM_PWMUDB_sP16_pwmdp_u1__A0_A1_REG, CYREG_UDB_CAT16_A_03
.set PWM_PWMUDB_sP16_pwmdp_u1__A0_REG, CYREG_UDB_W8_A0_03
.set PWM_PWMUDB_sP16_pwmdp_u1__A1_REG, CYREG_UDB_W8_A1_03
.set PWM_PWMUDB_sP16_pwmdp_u1__D0_D1_REG, CYREG_UDB_CAT16_D_03
.set PWM_PWMUDB_sP16_pwmdp_u1__D0_REG, CYREG_UDB_W8_D0_03
.set PWM_PWMUDB_sP16_pwmdp_u1__D1_REG, CYREG_UDB_W8_D1_03
.set PWM_PWMUDB_sP16_pwmdp_u1__DP_AUX_CTL_REG, CYREG_UDB_W8_ACTL_03
.set PWM_PWMUDB_sP16_pwmdp_u1__F0_F1_REG, CYREG_UDB_CAT16_F_03
.set PWM_PWMUDB_sP16_pwmdp_u1__F0_REG, CYREG_UDB_W8_F0_03
.set PWM_PWMUDB_sP16_pwmdp_u1__F1_REG, CYREG_UDB_W8_F1_03

/* IDAC_1 */
.set IDAC_1_cy_psoc4_idac__CONTROL, CYREG_CSD_CONFIG
.set IDAC_1_cy_psoc4_idac__CSD_IDAC, CYREG_CSD_IDAC
.set IDAC_1_cy_psoc4_idac__CSD_IDAC_SHIFT, 0
.set IDAC_1_cy_psoc4_idac__CSD_TRIM1, CYREG_CSD_TRIM1
.set IDAC_1_cy_psoc4_idac__CSD_TRIM1_SHIFT, 0
.set IDAC_1_cy_psoc4_idac__CSD_TRIM2, CYREG_CSD_TRIM2
.set IDAC_1_cy_psoc4_idac__CSD_TRIM2_SHIFT, 0
.set IDAC_1_cy_psoc4_idac__IDAC_NUMBER, 1
.set IDAC_1_cy_psoc4_idac__POLARITY, CYREG_CSD_CONFIG
.set IDAC_1_cy_psoc4_idac__POLARITY_SHIFT, 16

/* Clock_1 */
.set Clock_1__DIVIDER_MASK, 0x0000FFFF
.set Clock_1__ENABLE, CYREG_CLK_DIVIDER_A00
.set Clock_1__ENABLE_MASK, 0x80000000
.set Clock_1__MASK, 0x80000000
.set Clock_1__REGISTER, CYREG_CLK_DIVIDER_A00

/* ACT_Vout */
.set ACT_Vout__INTC_CLR_EN_REG, CYREG_CM0_ICER
.set ACT_Vout__INTC_CLR_PD_REG, CYREG_CM0_ICPR
.set ACT_Vout__INTC_MASK, 0x01
.set ACT_Vout__INTC_NUMBER, 0
.set ACT_Vout__INTC_PRIOR_MASK, 0xC0
.set ACT_Vout__INTC_PRIOR_NUM, 2
.set ACT_Vout__INTC_PRIOR_REG, CYREG_CM0_IPR0
.set ACT_Vout__INTC_SET_EN_REG, CYREG_CM0_ISER
.set ACT_Vout__INTC_SET_PD_REG, CYREG_CM0_ISPR

/* Iout_neg */
.set Iout_neg__0__DM__MASK, 0x1C0
.set Iout_neg__0__DM__SHIFT, 6
.set Iout_neg__0__DR, CYREG_PRT1_DR
.set Iout_neg__0__HSIOM, CYREG_HSIOM_PORT_SEL1
.set Iout_neg__0__HSIOM_MASK, 0x00000F00
.set Iout_neg__0__HSIOM_SHIFT, 8
.set Iout_neg__0__INTCFG, CYREG_PRT1_INTCFG
.set Iout_neg__0__INTSTAT, CYREG_PRT1_INTSTAT
.set Iout_neg__0__MASK, 0x04
.set Iout_neg__0__OUT_SEL, CYREG_UDB_PA1_CFG10
.set Iout_neg__0__OUT_SEL_SHIFT, 4
.set Iout_neg__0__OUT_SEL_VAL, 3
.set Iout_neg__0__PA__CFG0, CYREG_UDB_PA1_CFG0
.set Iout_neg__0__PA__CFG1, CYREG_UDB_PA1_CFG1
.set Iout_neg__0__PA__CFG10, CYREG_UDB_PA1_CFG10
.set Iout_neg__0__PA__CFG11, CYREG_UDB_PA1_CFG11
.set Iout_neg__0__PA__CFG12, CYREG_UDB_PA1_CFG12
.set Iout_neg__0__PA__CFG13, CYREG_UDB_PA1_CFG13
.set Iout_neg__0__PA__CFG14, CYREG_UDB_PA1_CFG14
.set Iout_neg__0__PA__CFG2, CYREG_UDB_PA1_CFG2
.set Iout_neg__0__PA__CFG3, CYREG_UDB_PA1_CFG3
.set Iout_neg__0__PA__CFG4, CYREG_UDB_PA1_CFG4
.set Iout_neg__0__PA__CFG5, CYREG_UDB_PA1_CFG5
.set Iout_neg__0__PA__CFG6, CYREG_UDB_PA1_CFG6
.set Iout_neg__0__PA__CFG7, CYREG_UDB_PA1_CFG7
.set Iout_neg__0__PA__CFG8, CYREG_UDB_PA1_CFG8
.set Iout_neg__0__PA__CFG9, CYREG_UDB_PA1_CFG9
.set Iout_neg__0__PC, CYREG_PRT1_PC
.set Iout_neg__0__PC2, CYREG_PRT1_PC2
.set Iout_neg__0__PORT, 1
.set Iout_neg__0__PS, CYREG_PRT1_PS
.set Iout_neg__0__SHIFT, 2
.set Iout_neg__DR, CYREG_PRT1_DR
.set Iout_neg__INTCFG, CYREG_PRT1_INTCFG
.set Iout_neg__INTSTAT, CYREG_PRT1_INTSTAT
.set Iout_neg__MASK, 0x04
.set Iout_neg__PA__CFG0, CYREG_UDB_PA1_CFG0
.set Iout_neg__PA__CFG1, CYREG_UDB_PA1_CFG1
.set Iout_neg__PA__CFG10, CYREG_UDB_PA1_CFG10
.set Iout_neg__PA__CFG11, CYREG_UDB_PA1_CFG11
.set Iout_neg__PA__CFG12, CYREG_UDB_PA1_CFG12
.set Iout_neg__PA__CFG13, CYREG_UDB_PA1_CFG13
.set Iout_neg__PA__CFG14, CYREG_UDB_PA1_CFG14
.set Iout_neg__PA__CFG2, CYREG_UDB_PA1_CFG2
.set Iout_neg__PA__CFG3, CYREG_UDB_PA1_CFG3
.set Iout_neg__PA__CFG4, CYREG_UDB_PA1_CFG4
.set Iout_neg__PA__CFG5, CYREG_UDB_PA1_CFG5
.set Iout_neg__PA__CFG6, CYREG_UDB_PA1_CFG6
.set Iout_neg__PA__CFG7, CYREG_UDB_PA1_CFG7
.set Iout_neg__PA__CFG8, CYREG_UDB_PA1_CFG8
.set Iout_neg__PA__CFG9, CYREG_UDB_PA1_CFG9
.set Iout_neg__PC, CYREG_PRT1_PC
.set Iout_neg__PC2, CYREG_PRT1_PC2
.set Iout_neg__PORT, 1
.set Iout_neg__PS, CYREG_PRT1_PS
.set Iout_neg__SHIFT, 2

/* Iout_pos */
.set Iout_pos__0__DM__MASK, 0x7000
.set Iout_pos__0__DM__SHIFT, 12
.set Iout_pos__0__DR, CYREG_PRT1_DR
.set Iout_pos__0__HSIOM, CYREG_HSIOM_PORT_SEL1
.set Iout_pos__0__HSIOM_MASK, 0x000F0000
.set Iout_pos__0__HSIOM_SHIFT, 16
.set Iout_pos__0__INTCFG, CYREG_PRT1_INTCFG
.set Iout_pos__0__INTSTAT, CYREG_PRT1_INTSTAT
.set Iout_pos__0__MASK, 0x10
.set Iout_pos__0__OUT_SEL, CYREG_UDB_PA1_CFG10
.set Iout_pos__0__OUT_SEL_SHIFT, 8
.set Iout_pos__0__OUT_SEL_VAL, 2
.set Iout_pos__0__PA__CFG0, CYREG_UDB_PA1_CFG0
.set Iout_pos__0__PA__CFG1, CYREG_UDB_PA1_CFG1
.set Iout_pos__0__PA__CFG10, CYREG_UDB_PA1_CFG10
.set Iout_pos__0__PA__CFG11, CYREG_UDB_PA1_CFG11
.set Iout_pos__0__PA__CFG12, CYREG_UDB_PA1_CFG12
.set Iout_pos__0__PA__CFG13, CYREG_UDB_PA1_CFG13
.set Iout_pos__0__PA__CFG14, CYREG_UDB_PA1_CFG14
.set Iout_pos__0__PA__CFG2, CYREG_UDB_PA1_CFG2
.set Iout_pos__0__PA__CFG3, CYREG_UDB_PA1_CFG3
.set Iout_pos__0__PA__CFG4, CYREG_UDB_PA1_CFG4
.set Iout_pos__0__PA__CFG5, CYREG_UDB_PA1_CFG5
.set Iout_pos__0__PA__CFG6, CYREG_UDB_PA1_CFG6
.set Iout_pos__0__PA__CFG7, CYREG_UDB_PA1_CFG7
.set Iout_pos__0__PA__CFG8, CYREG_UDB_PA1_CFG8
.set Iout_pos__0__PA__CFG9, CYREG_UDB_PA1_CFG9
.set Iout_pos__0__PC, CYREG_PRT1_PC
.set Iout_pos__0__PC2, CYREG_PRT1_PC2
.set Iout_pos__0__PORT, 1
.set Iout_pos__0__PS, CYREG_PRT1_PS
.set Iout_pos__0__SHIFT, 4
.set Iout_pos__DR, CYREG_PRT1_DR
.set Iout_pos__INTCFG, CYREG_PRT1_INTCFG
.set Iout_pos__INTSTAT, CYREG_PRT1_INTSTAT
.set Iout_pos__MASK, 0x10
.set Iout_pos__PA__CFG0, CYREG_UDB_PA1_CFG0
.set Iout_pos__PA__CFG1, CYREG_UDB_PA1_CFG1
.set Iout_pos__PA__CFG10, CYREG_UDB_PA1_CFG10
.set Iout_pos__PA__CFG11, CYREG_UDB_PA1_CFG11
.set Iout_pos__PA__CFG12, CYREG_UDB_PA1_CFG12
.set Iout_pos__PA__CFG13, CYREG_UDB_PA1_CFG13
.set Iout_pos__PA__CFG14, CYREG_UDB_PA1_CFG14
.set Iout_pos__PA__CFG2, CYREG_UDB_PA1_CFG2
.set Iout_pos__PA__CFG3, CYREG_UDB_PA1_CFG3
.set Iout_pos__PA__CFG4, CYREG_UDB_PA1_CFG4
.set Iout_pos__PA__CFG5, CYREG_UDB_PA1_CFG5
.set Iout_pos__PA__CFG6, CYREG_UDB_PA1_CFG6
.set Iout_pos__PA__CFG7, CYREG_UDB_PA1_CFG7
.set Iout_pos__PA__CFG8, CYREG_UDB_PA1_CFG8
.set Iout_pos__PA__CFG9, CYREG_UDB_PA1_CFG9
.set Iout_pos__PC, CYREG_PRT1_PC
.set Iout_pos__PC2, CYREG_PRT1_PC2
.set Iout_pos__PORT, 1
.set Iout_pos__PS, CYREG_PRT1_PS
.set Iout_pos__SHIFT, 4

/* SW1_Vout */
.set SW1_Vout__0__DM__MASK, 0xE00000
.set SW1_Vout__0__DM__SHIFT, 21
.set SW1_Vout__0__DR, CYREG_PRT0_DR
.set SW1_Vout__0__HSIOM, CYREG_HSIOM_PORT_SEL0
.set SW1_Vout__0__HSIOM_MASK, 0xF0000000
.set SW1_Vout__0__HSIOM_SHIFT, 28
.set SW1_Vout__0__INTCFG, CYREG_PRT0_INTCFG
.set SW1_Vout__0__INTSTAT, CYREG_PRT0_INTSTAT
.set SW1_Vout__0__MASK, 0x80
.set SW1_Vout__0__PA__CFG0, CYREG_UDB_PA0_CFG0
.set SW1_Vout__0__PA__CFG1, CYREG_UDB_PA0_CFG1
.set SW1_Vout__0__PA__CFG10, CYREG_UDB_PA0_CFG10
.set SW1_Vout__0__PA__CFG11, CYREG_UDB_PA0_CFG11
.set SW1_Vout__0__PA__CFG12, CYREG_UDB_PA0_CFG12
.set SW1_Vout__0__PA__CFG13, CYREG_UDB_PA0_CFG13
.set SW1_Vout__0__PA__CFG14, CYREG_UDB_PA0_CFG14
.set SW1_Vout__0__PA__CFG2, CYREG_UDB_PA0_CFG2
.set SW1_Vout__0__PA__CFG3, CYREG_UDB_PA0_CFG3
.set SW1_Vout__0__PA__CFG4, CYREG_UDB_PA0_CFG4
.set SW1_Vout__0__PA__CFG5, CYREG_UDB_PA0_CFG5
.set SW1_Vout__0__PA__CFG6, CYREG_UDB_PA0_CFG6
.set SW1_Vout__0__PA__CFG7, CYREG_UDB_PA0_CFG7
.set SW1_Vout__0__PA__CFG8, CYREG_UDB_PA0_CFG8
.set SW1_Vout__0__PA__CFG9, CYREG_UDB_PA0_CFG9
.set SW1_Vout__0__PC, CYREG_PRT0_PC
.set SW1_Vout__0__PC2, CYREG_PRT0_PC2
.set SW1_Vout__0__PORT, 0
.set SW1_Vout__0__PS, CYREG_PRT0_PS
.set SW1_Vout__0__SHIFT, 7
.set SW1_Vout__DR, CYREG_PRT0_DR
.set SW1_Vout__INTCFG, CYREG_PRT0_INTCFG
.set SW1_Vout__INTSTAT, CYREG_PRT0_INTSTAT
.set SW1_Vout__MASK, 0x80
.set SW1_Vout__PA__CFG0, CYREG_UDB_PA0_CFG0
.set SW1_Vout__PA__CFG1, CYREG_UDB_PA0_CFG1
.set SW1_Vout__PA__CFG10, CYREG_UDB_PA0_CFG10
.set SW1_Vout__PA__CFG11, CYREG_UDB_PA0_CFG11
.set SW1_Vout__PA__CFG12, CYREG_UDB_PA0_CFG12
.set SW1_Vout__PA__CFG13, CYREG_UDB_PA0_CFG13
.set SW1_Vout__PA__CFG14, CYREG_UDB_PA0_CFG14
.set SW1_Vout__PA__CFG2, CYREG_UDB_PA0_CFG2
.set SW1_Vout__PA__CFG3, CYREG_UDB_PA0_CFG3
.set SW1_Vout__PA__CFG4, CYREG_UDB_PA0_CFG4
.set SW1_Vout__PA__CFG5, CYREG_UDB_PA0_CFG5
.set SW1_Vout__PA__CFG6, CYREG_UDB_PA0_CFG6
.set SW1_Vout__PA__CFG7, CYREG_UDB_PA0_CFG7
.set SW1_Vout__PA__CFG8, CYREG_UDB_PA0_CFG8
.set SW1_Vout__PA__CFG9, CYREG_UDB_PA0_CFG9
.set SW1_Vout__PC, CYREG_PRT0_PC
.set SW1_Vout__PC2, CYREG_PRT0_PC2
.set SW1_Vout__PORT, 0
.set SW1_Vout__PS, CYREG_PRT0_PS
.set SW1_Vout__SHIFT, 7
.set SW1_Vout__SNAP, CYREG_PRT0_INTSTAT

/* DutyC_Vout */
.set DutyC_Vout__0__DM__MASK, 0x38
.set DutyC_Vout__0__DM__SHIFT, 3
.set DutyC_Vout__0__DR, CYREG_PRT2_DR
.set DutyC_Vout__0__HSIOM, CYREG_HSIOM_PORT_SEL2
.set DutyC_Vout__0__HSIOM_MASK, 0x000000F0
.set DutyC_Vout__0__HSIOM_SHIFT, 4
.set DutyC_Vout__0__INTCFG, CYREG_PRT2_INTCFG
.set DutyC_Vout__0__INTSTAT, CYREG_PRT2_INTSTAT
.set DutyC_Vout__0__MASK, 0x02
.set DutyC_Vout__0__PA__CFG0, CYREG_UDB_PA2_CFG0
.set DutyC_Vout__0__PA__CFG1, CYREG_UDB_PA2_CFG1
.set DutyC_Vout__0__PA__CFG10, CYREG_UDB_PA2_CFG10
.set DutyC_Vout__0__PA__CFG11, CYREG_UDB_PA2_CFG11
.set DutyC_Vout__0__PA__CFG12, CYREG_UDB_PA2_CFG12
.set DutyC_Vout__0__PA__CFG13, CYREG_UDB_PA2_CFG13
.set DutyC_Vout__0__PA__CFG14, CYREG_UDB_PA2_CFG14
.set DutyC_Vout__0__PA__CFG2, CYREG_UDB_PA2_CFG2
.set DutyC_Vout__0__PA__CFG3, CYREG_UDB_PA2_CFG3
.set DutyC_Vout__0__PA__CFG4, CYREG_UDB_PA2_CFG4
.set DutyC_Vout__0__PA__CFG5, CYREG_UDB_PA2_CFG5
.set DutyC_Vout__0__PA__CFG6, CYREG_UDB_PA2_CFG6
.set DutyC_Vout__0__PA__CFG7, CYREG_UDB_PA2_CFG7
.set DutyC_Vout__0__PA__CFG8, CYREG_UDB_PA2_CFG8
.set DutyC_Vout__0__PA__CFG9, CYREG_UDB_PA2_CFG9
.set DutyC_Vout__0__PC, CYREG_PRT2_PC
.set DutyC_Vout__0__PC2, CYREG_PRT2_PC2
.set DutyC_Vout__0__PORT, 2
.set DutyC_Vout__0__PS, CYREG_PRT2_PS
.set DutyC_Vout__0__SHIFT, 1
.set DutyC_Vout__DR, CYREG_PRT2_DR
.set DutyC_Vout__INTCFG, CYREG_PRT2_INTCFG
.set DutyC_Vout__INTSTAT, CYREG_PRT2_INTSTAT
.set DutyC_Vout__MASK, 0x02
.set DutyC_Vout__PA__CFG0, CYREG_UDB_PA2_CFG0
.set DutyC_Vout__PA__CFG1, CYREG_UDB_PA2_CFG1
.set DutyC_Vout__PA__CFG10, CYREG_UDB_PA2_CFG10
.set DutyC_Vout__PA__CFG11, CYREG_UDB_PA2_CFG11
.set DutyC_Vout__PA__CFG12, CYREG_UDB_PA2_CFG12
.set DutyC_Vout__PA__CFG13, CYREG_UDB_PA2_CFG13
.set DutyC_Vout__PA__CFG14, CYREG_UDB_PA2_CFG14
.set DutyC_Vout__PA__CFG2, CYREG_UDB_PA2_CFG2
.set DutyC_Vout__PA__CFG3, CYREG_UDB_PA2_CFG3
.set DutyC_Vout__PA__CFG4, CYREG_UDB_PA2_CFG4
.set DutyC_Vout__PA__CFG5, CYREG_UDB_PA2_CFG5
.set DutyC_Vout__PA__CFG6, CYREG_UDB_PA2_CFG6
.set DutyC_Vout__PA__CFG7, CYREG_UDB_PA2_CFG7
.set DutyC_Vout__PA__CFG8, CYREG_UDB_PA2_CFG8
.set DutyC_Vout__PA__CFG9, CYREG_UDB_PA2_CFG9
.set DutyC_Vout__PC, CYREG_PRT2_PC
.set DutyC_Vout__PC2, CYREG_PRT2_PC2
.set DutyC_Vout__PORT, 2
.set DutyC_Vout__PS, CYREG_PRT2_PS
.set DutyC_Vout__SHIFT, 1

/* Nivel_Vout */
.set Nivel_Vout__0__DM__MASK, 0x07
.set Nivel_Vout__0__DM__SHIFT, 0
.set Nivel_Vout__0__DR, CYREG_PRT2_DR
.set Nivel_Vout__0__HSIOM, CYREG_HSIOM_PORT_SEL2
.set Nivel_Vout__0__HSIOM_MASK, 0x0000000F
.set Nivel_Vout__0__HSIOM_SHIFT, 0
.set Nivel_Vout__0__INTCFG, CYREG_PRT2_INTCFG
.set Nivel_Vout__0__INTSTAT, CYREG_PRT2_INTSTAT
.set Nivel_Vout__0__MASK, 0x01
.set Nivel_Vout__0__PA__CFG0, CYREG_UDB_PA2_CFG0
.set Nivel_Vout__0__PA__CFG1, CYREG_UDB_PA2_CFG1
.set Nivel_Vout__0__PA__CFG10, CYREG_UDB_PA2_CFG10
.set Nivel_Vout__0__PA__CFG11, CYREG_UDB_PA2_CFG11
.set Nivel_Vout__0__PA__CFG12, CYREG_UDB_PA2_CFG12
.set Nivel_Vout__0__PA__CFG13, CYREG_UDB_PA2_CFG13
.set Nivel_Vout__0__PA__CFG14, CYREG_UDB_PA2_CFG14
.set Nivel_Vout__0__PA__CFG2, CYREG_UDB_PA2_CFG2
.set Nivel_Vout__0__PA__CFG3, CYREG_UDB_PA2_CFG3
.set Nivel_Vout__0__PA__CFG4, CYREG_UDB_PA2_CFG4
.set Nivel_Vout__0__PA__CFG5, CYREG_UDB_PA2_CFG5
.set Nivel_Vout__0__PA__CFG6, CYREG_UDB_PA2_CFG6
.set Nivel_Vout__0__PA__CFG7, CYREG_UDB_PA2_CFG7
.set Nivel_Vout__0__PA__CFG8, CYREG_UDB_PA2_CFG8
.set Nivel_Vout__0__PA__CFG9, CYREG_UDB_PA2_CFG9
.set Nivel_Vout__0__PC, CYREG_PRT2_PC
.set Nivel_Vout__0__PC2, CYREG_PRT2_PC2
.set Nivel_Vout__0__PORT, 2
.set Nivel_Vout__0__PS, CYREG_PRT2_PS
.set Nivel_Vout__0__SHIFT, 0
.set Nivel_Vout__DR, CYREG_PRT2_DR
.set Nivel_Vout__INTCFG, CYREG_PRT2_INTCFG
.set Nivel_Vout__INTSTAT, CYREG_PRT2_INTSTAT
.set Nivel_Vout__MASK, 0x01
.set Nivel_Vout__PA__CFG0, CYREG_UDB_PA2_CFG0
.set Nivel_Vout__PA__CFG1, CYREG_UDB_PA2_CFG1
.set Nivel_Vout__PA__CFG10, CYREG_UDB_PA2_CFG10
.set Nivel_Vout__PA__CFG11, CYREG_UDB_PA2_CFG11
.set Nivel_Vout__PA__CFG12, CYREG_UDB_PA2_CFG12
.set Nivel_Vout__PA__CFG13, CYREG_UDB_PA2_CFG13
.set Nivel_Vout__PA__CFG14, CYREG_UDB_PA2_CFG14
.set Nivel_Vout__PA__CFG2, CYREG_UDB_PA2_CFG2
.set Nivel_Vout__PA__CFG3, CYREG_UDB_PA2_CFG3
.set Nivel_Vout__PA__CFG4, CYREG_UDB_PA2_CFG4
.set Nivel_Vout__PA__CFG5, CYREG_UDB_PA2_CFG5
.set Nivel_Vout__PA__CFG6, CYREG_UDB_PA2_CFG6
.set Nivel_Vout__PA__CFG7, CYREG_UDB_PA2_CFG7
.set Nivel_Vout__PA__CFG8, CYREG_UDB_PA2_CFG8
.set Nivel_Vout__PA__CFG9, CYREG_UDB_PA2_CFG9
.set Nivel_Vout__PC, CYREG_PRT2_PC
.set Nivel_Vout__PC2, CYREG_PRT2_PC2
.set Nivel_Vout__PORT, 2
.set Nivel_Vout__PS, CYREG_PRT2_PS
.set Nivel_Vout__SHIFT, 0

/* PWMComp_INT */
.set PWMComp_INT__INTC_CLR_EN_REG, CYREG_CM0_ICER
.set PWMComp_INT__INTC_CLR_PD_REG, CYREG_CM0_ICPR
.set PWMComp_INT__INTC_MASK, 0x02
.set PWMComp_INT__INTC_NUMBER, 1
.set PWMComp_INT__INTC_PRIOR_MASK, 0xC000
.set PWMComp_INT__INTC_PRIOR_NUM, 3
.set PWMComp_INT__INTC_PRIOR_REG, CYREG_CM0_IPR0
.set PWMComp_INT__INTC_SET_EN_REG, CYREG_CM0_ISER
.set PWMComp_INT__INTC_SET_PD_REG, CYREG_CM0_ISPR

/* PWMPeri_INT */
.set PWMPeri_INT__INTC_CLR_EN_REG, CYREG_CM0_ICER
.set PWMPeri_INT__INTC_CLR_PD_REG, CYREG_CM0_ICPR
.set PWMPeri_INT__INTC_MASK, 0x04
.set PWMPeri_INT__INTC_NUMBER, 2
.set PWMPeri_INT__INTC_PRIOR_MASK, 0xC00000
.set PWMPeri_INT__INTC_PRIOR_NUM, 3
.set PWMPeri_INT__INTC_PRIOR_REG, CYREG_CM0_IPR0
.set PWMPeri_INT__INTC_SET_EN_REG, CYREG_CM0_ISER
.set PWMPeri_INT__INTC_SET_PD_REG, CYREG_CM0_ISPR

/* PERIODO_Vout */
.set PERIODO_Vout__0__DM__MASK, 0x1C0
.set PERIODO_Vout__0__DM__SHIFT, 6
.set PERIODO_Vout__0__DR, CYREG_PRT2_DR
.set PERIODO_Vout__0__HSIOM, CYREG_HSIOM_PORT_SEL2
.set PERIODO_Vout__0__HSIOM_MASK, 0x00000F00
.set PERIODO_Vout__0__HSIOM_SHIFT, 8
.set PERIODO_Vout__0__INTCFG, CYREG_PRT2_INTCFG
.set PERIODO_Vout__0__INTSTAT, CYREG_PRT2_INTSTAT
.set PERIODO_Vout__0__MASK, 0x04
.set PERIODO_Vout__0__PA__CFG0, CYREG_UDB_PA2_CFG0
.set PERIODO_Vout__0__PA__CFG1, CYREG_UDB_PA2_CFG1
.set PERIODO_Vout__0__PA__CFG10, CYREG_UDB_PA2_CFG10
.set PERIODO_Vout__0__PA__CFG11, CYREG_UDB_PA2_CFG11
.set PERIODO_Vout__0__PA__CFG12, CYREG_UDB_PA2_CFG12
.set PERIODO_Vout__0__PA__CFG13, CYREG_UDB_PA2_CFG13
.set PERIODO_Vout__0__PA__CFG14, CYREG_UDB_PA2_CFG14
.set PERIODO_Vout__0__PA__CFG2, CYREG_UDB_PA2_CFG2
.set PERIODO_Vout__0__PA__CFG3, CYREG_UDB_PA2_CFG3
.set PERIODO_Vout__0__PA__CFG4, CYREG_UDB_PA2_CFG4
.set PERIODO_Vout__0__PA__CFG5, CYREG_UDB_PA2_CFG5
.set PERIODO_Vout__0__PA__CFG6, CYREG_UDB_PA2_CFG6
.set PERIODO_Vout__0__PA__CFG7, CYREG_UDB_PA2_CFG7
.set PERIODO_Vout__0__PA__CFG8, CYREG_UDB_PA2_CFG8
.set PERIODO_Vout__0__PA__CFG9, CYREG_UDB_PA2_CFG9
.set PERIODO_Vout__0__PC, CYREG_PRT2_PC
.set PERIODO_Vout__0__PC2, CYREG_PRT2_PC2
.set PERIODO_Vout__0__PORT, 2
.set PERIODO_Vout__0__PS, CYREG_PRT2_PS
.set PERIODO_Vout__0__SHIFT, 2
.set PERIODO_Vout__DR, CYREG_PRT2_DR
.set PERIODO_Vout__INTCFG, CYREG_PRT2_INTCFG
.set PERIODO_Vout__INTSTAT, CYREG_PRT2_INTSTAT
.set PERIODO_Vout__MASK, 0x04
.set PERIODO_Vout__PA__CFG0, CYREG_UDB_PA2_CFG0
.set PERIODO_Vout__PA__CFG1, CYREG_UDB_PA2_CFG1
.set PERIODO_Vout__PA__CFG10, CYREG_UDB_PA2_CFG10
.set PERIODO_Vout__PA__CFG11, CYREG_UDB_PA2_CFG11
.set PERIODO_Vout__PA__CFG12, CYREG_UDB_PA2_CFG12
.set PERIODO_Vout__PA__CFG13, CYREG_UDB_PA2_CFG13
.set PERIODO_Vout__PA__CFG14, CYREG_UDB_PA2_CFG14
.set PERIODO_Vout__PA__CFG2, CYREG_UDB_PA2_CFG2
.set PERIODO_Vout__PA__CFG3, CYREG_UDB_PA2_CFG3
.set PERIODO_Vout__PA__CFG4, CYREG_UDB_PA2_CFG4
.set PERIODO_Vout__PA__CFG5, CYREG_UDB_PA2_CFG5
.set PERIODO_Vout__PA__CFG6, CYREG_UDB_PA2_CFG6
.set PERIODO_Vout__PA__CFG7, CYREG_UDB_PA2_CFG7
.set PERIODO_Vout__PA__CFG8, CYREG_UDB_PA2_CFG8
.set PERIODO_Vout__PA__CFG9, CYREG_UDB_PA2_CFG9
.set PERIODO_Vout__PC, CYREG_PRT2_PC
.set PERIODO_Vout__PC2, CYREG_PRT2_PC2
.set PERIODO_Vout__PORT, 2
.set PERIODO_Vout__PS, CYREG_PRT2_PS
.set PERIODO_Vout__SHIFT, 2

/* Miscellaneous */
.set CYDEV_BCLK__HFCLK__HZ, 48000000
.set CYDEV_BCLK__HFCLK__KHZ, 48000
.set CYDEV_BCLK__HFCLK__MHZ, 48
.set CYDEV_BCLK__SYSCLK__HZ, 48000000
.set CYDEV_BCLK__SYSCLK__KHZ, 48000
.set CYDEV_BCLK__SYSCLK__MHZ, 48
.set CYDEV_CHIP_DIE_LEOPARD, 1
.set CYDEV_CHIP_DIE_PSOC4A, 26
.set CYDEV_CHIP_DIE_PSOC5LP, 2
.set CYDEV_CHIP_DIE_PSOC5TM, 3
.set CYDEV_CHIP_DIE_TMA4, 4
.set CYDEV_CHIP_DIE_UNKNOWN, 0
.set CYDEV_CHIP_FAMILY_FM0P, 5
.set CYDEV_CHIP_FAMILY_FM3, 6
.set CYDEV_CHIP_FAMILY_FM4, 7
.set CYDEV_CHIP_FAMILY_PSOC3, 1
.set CYDEV_CHIP_FAMILY_PSOC4, 2
.set CYDEV_CHIP_FAMILY_PSOC5, 3
.set CYDEV_CHIP_FAMILY_PSOC6, 4
.set CYDEV_CHIP_FAMILY_UNKNOWN, 0
.set CYDEV_CHIP_FAMILY_USED, CYDEV_CHIP_FAMILY_PSOC4
.set CYDEV_CHIP_JTAG_ID, 0x04C81193
.set CYDEV_CHIP_MEMBER_3A, 1
.set CYDEV_CHIP_MEMBER_4A, 26
.set CYDEV_CHIP_MEMBER_4AA, 25
.set CYDEV_CHIP_MEMBER_4AB, 30
.set CYDEV_CHIP_MEMBER_4AC, 14
.set CYDEV_CHIP_MEMBER_4AD, 15
.set CYDEV_CHIP_MEMBER_4AE, 16
.set CYDEV_CHIP_MEMBER_4D, 20
.set CYDEV_CHIP_MEMBER_4E, 6
.set CYDEV_CHIP_MEMBER_4F, 27
.set CYDEV_CHIP_MEMBER_4G, 4
.set CYDEV_CHIP_MEMBER_4H, 24
.set CYDEV_CHIP_MEMBER_4I, 32
.set CYDEV_CHIP_MEMBER_4J, 21
.set CYDEV_CHIP_MEMBER_4K, 22
.set CYDEV_CHIP_MEMBER_4L, 31
.set CYDEV_CHIP_MEMBER_4M, 29
.set CYDEV_CHIP_MEMBER_4N, 11
.set CYDEV_CHIP_MEMBER_4O, 8
.set CYDEV_CHIP_MEMBER_4P, 28
.set CYDEV_CHIP_MEMBER_4Q, 17
.set CYDEV_CHIP_MEMBER_4R, 9
.set CYDEV_CHIP_MEMBER_4S, 12
.set CYDEV_CHIP_MEMBER_4T, 10
.set CYDEV_CHIP_MEMBER_4U, 5
.set CYDEV_CHIP_MEMBER_4V, 23
.set CYDEV_CHIP_MEMBER_4W, 13
.set CYDEV_CHIP_MEMBER_4X, 7
.set CYDEV_CHIP_MEMBER_4Y, 18
.set CYDEV_CHIP_MEMBER_4Z, 19
.set CYDEV_CHIP_MEMBER_5A, 3
.set CYDEV_CHIP_MEMBER_5B, 2
.set CYDEV_CHIP_MEMBER_6A, 33
.set CYDEV_CHIP_MEMBER_FM3, 37
.set CYDEV_CHIP_MEMBER_FM4, 38
.set CYDEV_CHIP_MEMBER_PDL_FM0P_TYPE1, 34
.set CYDEV_CHIP_MEMBER_PDL_FM0P_TYPE2, 35
.set CYDEV_CHIP_MEMBER_PDL_FM0P_TYPE3, 36
.set CYDEV_CHIP_MEMBER_UNKNOWN, 0
.set CYDEV_CHIP_MEMBER_USED, CYDEV_CHIP_MEMBER_4A
.set CYDEV_CHIP_DIE_EXPECT, CYDEV_CHIP_MEMBER_USED
.set CYDEV_CHIP_DIE_ACTUAL, CYDEV_CHIP_DIE_EXPECT
.set CYDEV_CHIP_REV_LEOPARD_ES1, 0
.set CYDEV_CHIP_REV_LEOPARD_ES2, 1
.set CYDEV_CHIP_REV_LEOPARD_ES3, 3
.set CYDEV_CHIP_REV_LEOPARD_PRODUCTION, 3
.set CYDEV_CHIP_REV_PSOC4A_ES0, 17
.set CYDEV_CHIP_REV_PSOC4A_PRODUCTION, 17
.set CYDEV_CHIP_REV_PSOC5LP_ES0, 0
.set CYDEV_CHIP_REV_PSOC5LP_PRODUCTION, 0
.set CYDEV_CHIP_REV_PSOC5TM_ES0, 0
.set CYDEV_CHIP_REV_PSOC5TM_ES1, 1
.set CYDEV_CHIP_REV_PSOC5TM_PRODUCTION, 1
.set CYDEV_CHIP_REV_TMA4_ES, 17
.set CYDEV_CHIP_REV_TMA4_ES2, 33
.set CYDEV_CHIP_REV_TMA4_PRODUCTION, 17
.set CYDEV_CHIP_REVISION_3A_ES1, 0
.set CYDEV_CHIP_REVISION_3A_ES2, 1
.set CYDEV_CHIP_REVISION_3A_ES3, 3
.set CYDEV_CHIP_REVISION_3A_PRODUCTION, 3
.set CYDEV_CHIP_REVISION_4A_ES0, 17
.set CYDEV_CHIP_REVISION_4A_PRODUCTION, 17
.set CYDEV_CHIP_REVISION_4AA_PRODUCTION, 0
.set CYDEV_CHIP_REVISION_4AB_PRODUCTION, 0
.set CYDEV_CHIP_REVISION_4AC_PRODUCTION, 0
.set CYDEV_CHIP_REVISION_4AD_PRODUCTION, 0
.set CYDEV_CHIP_REVISION_4AE_PRODUCTION, 0
.set CYDEV_CHIP_REVISION_4D_PRODUCTION, 0
.set CYDEV_CHIP_REVISION_4E_CCG2_NO_USBPD, 0
.set CYDEV_CHIP_REVISION_4E_PRODUCTION, 0
.set CYDEV_CHIP_REVISION_4F_PRODUCTION, 0
.set CYDEV_CHIP_REVISION_4F_PRODUCTION_256DMA, 0
.set CYDEV_CHIP_REVISION_4F_PRODUCTION_256K, 0
.set CYDEV_CHIP_REVISION_4G_ES, 17
.set CYDEV_CHIP_REVISION_4G_ES2, 33
.set CYDEV_CHIP_REVISION_4G_PRODUCTION, 17
.set CYDEV_CHIP_REVISION_4H_PRODUCTION, 0
.set CYDEV_CHIP_REVISION_4I_PRODUCTION, 0
.set CYDEV_CHIP_REVISION_4J_PRODUCTION, 0
.set CYDEV_CHIP_REVISION_4K_PRODUCTION, 0
.set CYDEV_CHIP_REVISION_4L_PRODUCTION, 0
.set CYDEV_CHIP_REVISION_4M_PRODUCTION, 0
.set CYDEV_CHIP_REVISION_4N_PRODUCTION, 0
.set CYDEV_CHIP_REVISION_4O_PRODUCTION, 0
.set CYDEV_CHIP_REVISION_4P_PRODUCTION, 0
.set CYDEV_CHIP_REVISION_4Q_PRODUCTION, 0
.set CYDEV_CHIP_REVISION_4R_PRODUCTION, 0
.set CYDEV_CHIP_REVISION_4S_PRODUCTION, 0
.set CYDEV_CHIP_REVISION_4T_PRODUCTION, 0
.set CYDEV_CHIP_REVISION_4U_PRODUCTION, 0
.set CYDEV_CHIP_REVISION_4V_PRODUCTION, 0
.set CYDEV_CHIP_REVISION_4W_PRODUCTION, 0
.set CYDEV_CHIP_REVISION_4X_PRODUCTION, 0
.set CYDEV_CHIP_REVISION_4Y_PRODUCTION, 0
.set CYDEV_CHIP_REVISION_4Z_PRODUCTION, 0
.set CYDEV_CHIP_REVISION_5A_ES0, 0
.set CYDEV_CHIP_REVISION_5A_ES1, 1
.set CYDEV_CHIP_REVISION_5A_PRODUCTION, 1
.set CYDEV_CHIP_REVISION_5B_ES0, 0
.set CYDEV_CHIP_REVISION_5B_PRODUCTION, 0
.set CYDEV_CHIP_REVISION_6A_ES, 17
.set CYDEV_CHIP_REVISION_6A_NO_UDB, 33
.set CYDEV_CHIP_REVISION_6A_PRODUCTION, 33
.set CYDEV_CHIP_REVISION_FM3_PRODUCTION, 0
.set CYDEV_CHIP_REVISION_FM4_PRODUCTION, 0
.set CYDEV_CHIP_REVISION_PDL_FM0P_TYPE1_PRODUCTION, 0
.set CYDEV_CHIP_REVISION_PDL_FM0P_TYPE2_PRODUCTION, 0
.set CYDEV_CHIP_REVISION_PDL_FM0P_TYPE3_PRODUCTION, 0
.set CYDEV_CHIP_REVISION_USED, CYDEV_CHIP_REVISION_4A_PRODUCTION
.set CYDEV_CHIP_REV_EXPECT, CYDEV_CHIP_REVISION_USED
.set CYDEV_CONFIG_READ_ACCELERATOR, 1
.set CYDEV_CONFIG_UNUSED_IO_AllowButWarn, 0
.set CYDEV_CONFIG_UNUSED_IO_AllowWithInfo, 1
.set CYDEV_CONFIG_UNUSED_IO_Disallowed, 2
.set CYDEV_CONFIG_UNUSED_IO, CYDEV_CONFIG_UNUSED_IO_Disallowed
.set CYDEV_CONFIGURATION_COMPRESSED, 1
.set CYDEV_CONFIGURATION_MODE_COMPRESSED, 0
.set CYDEV_CONFIGURATION_MODE, CYDEV_CONFIGURATION_MODE_COMPRESSED
.set CYDEV_CONFIGURATION_MODE_DMA, 2
.set CYDEV_CONFIGURATION_MODE_UNCOMPRESSED, 1
.set CYDEV_DEBUG_PROTECT_KILL, 4
.set CYDEV_DEBUG_PROTECT_OPEN, 1
.set CYDEV_DEBUG_PROTECT, CYDEV_DEBUG_PROTECT_OPEN
.set CYDEV_DEBUG_PROTECT_PROTECTED, 2
.set CYDEV_DEBUGGING_DPS_Disable, 3
.set CYDEV_DEBUGGING_DPS, CYDEV_DEBUGGING_DPS_Disable
.set CYDEV_DEBUGGING_DPS_SWD, 2
.set CYDEV_DEBUGGING_ENABLE, 0
.set CYDEV_DFT_SELECT_CLK0, 1
.set CYDEV_DFT_SELECT_CLK1, 2
.set CYDEV_HEAP_SIZE, 0x80
.set CYDEV_IMO_TRIMMED_BY_USB, 0
.set CYDEV_IMO_TRIMMED_BY_WCO, 0
.set CYDEV_IS_EXPORTING_CODE, 0
.set CYDEV_IS_IMPORTING_CODE, 0
.set CYDEV_PROJ_TYPE, 2
.set CYDEV_PROJ_TYPE_BOOTLOADER, 1
.set CYDEV_PROJ_TYPE_LAUNCHER, 5
.set CYDEV_PROJ_TYPE_LOADABLE, 2
.set CYDEV_PROJ_TYPE_LOADABLEANDBOOTLOADER, 4
.set CYDEV_PROJ_TYPE_MULTIAPPBOOTLOADER, 3
.set CYDEV_PROJ_TYPE_STANDARD, 0
.set CYDEV_STACK_SIZE, 0x0400
.set CYDEV_USE_BUNDLED_CMSIS, 1
.set CYDEV_VARIABLE_VDDA, 1
.set CYDEV_VDDA, 5
.set CYDEV_VDDA_MV, 5000
.set CYDEV_VDDD, 5
.set CYDEV_VDDD_MV, 5000
.set CYDEV_WDT_GENERATE_ISR, 1
.set CYIPBLOCK_M0S8_CTBM_VERSION, 0
.set CYIPBLOCK_m0s8cpuss_VERSION, 0
.set CYIPBLOCK_m0s8csd_VERSION, 0
.set CYIPBLOCK_m0s8gpio2_VERSION, 0
.set CYIPBLOCK_m0s8hsiom4a_VERSION, 0
.set CYIPBLOCK_m0s8lcd_VERSION, 0
.set CYIPBLOCK_m0s8lpcomp_VERSION, 0
.set CYIPBLOCK_m0s8pclk_VERSION, 0
.set CYIPBLOCK_m0s8sar_VERSION, 0
.set CYIPBLOCK_m0s8scb_VERSION, 0
.set CYIPBLOCK_m0s8srssv2_VERSION, 1
.set CYIPBLOCK_m0s8tcpwm_VERSION, 0
.set CYIPBLOCK_m0s8udbif_VERSION, 0
.set CYIPBLOCK_S8_GPIO_VERSION, 2
.set CYDEV_BOOTLOADER_ENABLE, 0
.endif
